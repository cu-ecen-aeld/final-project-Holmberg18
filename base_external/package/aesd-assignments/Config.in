## base_external/package/aesd-assignments/Config.in
```kconfig
config BR2_PACKAGE_AESD_ASSIGNMENTS
	bool "aesd-assignments"
	help
	  Assignment 3 and later applications
	  
	  https://github.com/Holmberg18/assignments-3-and-later-Holmberg18
```

## base_external/package/aesdchar/Config.in
```kconfig
config BR2_PACKAGE_AESDCHAR
        bool "aesdchar"
        help
          Includes aesdchar driver module
```

## base_external/package/ldd/Config.in
```kconfig
config BR2_PACKAGE_LDD
        bool "ldd"
        help
          Includes the misc-modules and scull components
```
